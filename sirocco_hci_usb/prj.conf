## CMakeLists.txt
```
# SPDX-License-Identifier: Apache-2.0

cmake_minimum_required(VERSION 3.20.0)
find_package(Zephyr REQUIRED HINTS $ENV{ZEPHYR_BASE})
project(sirocco_hci_usb)

target_sources(app PRIVATE src/main.c)
```

## prj.conf
```kconfig
CONFIG_BT=y
CONFIG_BT_HCI_RAW=y

CONFIG_USB_DEVICE_STACK=y
CONFIG_USB_DEVICE_PID=0x000B
CONFIG_USB_DEVICE_BLUETOOTH=y
CONFIG_USB_DEVICE_BLUETOOTH_VS_H4=n
CONFIG_USB_DEVICE_INITIALIZE_AT_BOOT=n

# We dont want any console or CDC ACM that may cause BlueZ to not detect hci_usb
CONFIG_SERIAL=n
CONFIG_CONSOLE=n
CONFIG_UART_CONSOLE=n

# Workaround: Unable to allocate command buffer when using K_NO_WAIT since
# Host number of completed commands does not follow normal flow control.
CONFIG_BT_BUF_CMD_TX_COUNT=10


#CONFIG_BT_DEVICE_NAME="Sirocco HCI USB"
# Open source Link Layer
CONFIG_BT_LL_SW_SPLIT=y
# Enable library for nRF button and LED
CONFIG_DK_LIBRARY=y
CONFIG_LOG=y


# Enable Sirocco Bluetooth IDS
#
CONFIG_BT_SIROCCO=y
#CONFIG_BT_SRCC_LOG_LEVEL=4
#
# Sirocco dependencies
#
CONFIG_NRFX_TIMER2=y
#CONFIG_HEAP_MEM_POOL_SIZE=4096
CONFIG_HEAP_MEM_POOL_SIZE=8192
CONFIG_SYS_HASH_FUNC32=y
CONFIG_SYS_HASH_MAP=y
#
# Enable detection modules
#
CONFIG_BT_SRCC_BTLEJACK=y
CONFIG_BT_SRCC_OASIS_GATTACKER=y
CONFIG_BT_SRCC_INJECTABLE=y
CONFIG_BT_SRCC_KNOB=y
#
# Detection module dependencies
#
# Enable ring buffer for Oasis GATTacker module
CONFIG_RING_BUFFER=y
```

## src/main.c
```c
/*
 * Copyright (c) 2018 Intel Corporation
 *
 * SPDX-License-Identifier: Apache-2.0
 */

#include <zephyr/kernel.h>
#include <zephyr/sys/printk.h>
#include <zephyr/usb/usb_device.h>
#include <zephyr/usb/usbd.h>

#include <zephyr/bluetooth/sirocco.h>


#if defined(CONFIG_USB_DEVICE_STACK_NEXT)
USBD_CONFIGURATION_DEFINE(config_1,
			  USB_SCD_SELF_POWERED,
			  200);

USBD_DESC_LANG_DEFINE(sample_lang);
USBD_DESC_MANUFACTURER_DEFINE(sample_mfr, "ZEPHYR");
USBD_DESC_PRODUCT_DEFINE(sample_product, "Zephyr USBD BT HCI");
USBD_DESC_SERIAL_NUMBER_DEFINE(sample_sn, "0123456789ABCDEF");


USBD_DEVICE_DEFINE(sample_usbd,
		   DEVICE_DT_GET(DT_NODELABEL(zephyr_udc0)),
		   0x2fe3, 0x000b);

static int enable_usb_device_next(void)
{
	int err;

	err = usbd_add_descriptor(&sample_usbd, &sample_lang);
	if (err) {
		return err;
	}

	err = usbd_add_descriptor(&sample_usbd, &sample_mfr);
	if (err) {
		return err;
	}

	err = usbd_add_descriptor(&sample_usbd, &sample_product);
	if (err) {
		return err;
	}

	err = usbd_add_descriptor(&sample_usbd, &sample_sn);
	if (err) {
		return err;
	}

	err = usbd_add_configuration(&sample_usbd, &config_1);
	if (err) {
		return err;
	}

	err = usbd_register_class(&sample_usbd, "bt_hci_0", 1);
	if (err) {
		return err;
	}

	err = usbd_init(&sample_usbd);
	if (err) {
		return err;
	}

	err = usbd_enable(&sample_usbd);
	if (err) {
		return err;
	}

	return 0;
}
#endif /* CONFIG_USB_DEVICE_STACK_NEXT */

#if defined(CONFIG_BT_SIROCCO)
static int init_sirocco(void)
{
	/* Initialize Sirocco Zephyr subsystem */
	srcc_init();
 
    /* Register callbacks
    TODO
	srcc_cb_register(&cb);
    */

	return 0;
}
#endif

int main(void)
{
	int ret;

#if defined(CONFIG_USB_DEVICE_STACK_NEXT)
	ret = enable_usb_device_next();
#else
	ret = usb_enable(NULL);
#endif

	if (ret != 0) {
		printk("Failed to enable USB");
		return 0;
	}

	/* Initialize Sirocco Bluetooth IDS
     */
#if defined(CONFIG_BT_SIROCCO)
	ret = init_sirocco();
	if (ret) {
		printk("Sirocco Bluetooth IDS init failed (err %d)\n", ret);
		return 0;
	}
	printk("Sirocco Bluetooth IDS initialized\n");
#endif

	printk("Bluetooth over USB sample\n");
	return 0;
}
```
