## CMakeLists.txt
```
# SPDX-License-Identifier: Apache-2.0

cmake_minimum_required(VERSION 3.20.0)
find_package(Zephyr REQUIRED HINTS $ENV{ZEPHYR_BASE})
project(sirocco_observer)

target_sources(app PRIVATE
  src/main.c
  src/observer.c
)
```

## prj.conf
```kconfig
CONFIG_BT=y
CONFIG_BT_OBSERVER=y

CONFIG_BT_DEVICE_NAME="Sirocco Observer"
CONFIG_LOG=y
# Open source Link Layer
CONFIG_BT_LL_SW_SPLIT=y
# Enable library for nRF button and LED
CONFIG_DK_LIBRARY=y



# Enable Sirocco Bluetooth IDS
#
CONFIG_BT_SIROCCO=y
CONFIG_BT_SRCC_LOG_LEVEL=4
#
# Sirocco dependencies
#
CONFIG_NRFX_TIMER2=y
# For passing metrics between the ISR and sirocco thread
#CONFIG_HEAP_MEM_POOL_SIZE=8192
#CONFIG_HEAP_MEM_POOL_SIZE=16384
CONFIG_HEAP_MEM_POOL_SIZE=32768
# Hashmap are used to store data about devices
CONFIG_SYS_HASH_FUNC32=y
CONFIG_SYS_HASH_MAP=y
#
# Enable detection modules
#
CONFIG_BT_SRCC_OASIS_GATTACKER=y
#
# Detection module dependencies
#
# Enable ring buffer for Oasis GATTacker module
CONFIG_RING_BUFFER=y


# To measure Sirocco performances
#
#CONFIG_NRFX_TIMER3=y
#CONFIG_SRCC_ANALYSIS=y
#CONFIG_SRCC_ISR_LATENCY=y
#CONFIG_SRCC_FIFO_LATENCY=y
#CONFIG_SRCC_E2E_LATENCY=y
```

## src/main.c
```c
/*
 * Copyright (c) 2022 Nordic Semiconductor ASA
 *
 * SPDX-License-Identifier: Apache-2.0
 */

#include <zephyr/sys/printk.h>
#include <zephyr/bluetooth/bluetooth.h>

#include <zephyr/bluetooth/sirocco.h>



int observer_start(void);


#if defined(CONFIG_BT_SIROCCO)
int init_sirocco(void)
{
	/* Initialize Sirocco Zephyr subsystem */
	srcc_init();
	return 0;
}
#endif

int main(void)
{
	int err;

	printk("Starting Observer Demo\n");

	/* Initialize the Bluetooth Subsystem */
	err = bt_enable(NULL);
	if (err) {
		printk("Bluetooth init failed (err %d)\n", err);
		return 0;
	}

    /* Initialized latency analysis
     */
#if defined(CONFIG_SRCC_ANALYSIS)
    init_srcc_analysis();
#endif

	/* Initialize Sirocco Bluetooth IDS
     */
#if defined(CONFIG_BT_SIROCCO)
	err = init_sirocco();
	if (err) {
		printk("Sirocco Bluetooth IDS init failed (err %d)\n", err);
		return 0;
	}
	printk("Sirocco Bluetooth IDS initialized\n");
#endif

	(void)observer_start();

	printk("Exiting %s thread.\n", __func__);
	return 0;
}
```

## src/observer.c
```c
/*
 * Copyright (c) 2022 Nordic Semiconductor ASA
 * Copyright (c) 2015-2016 Intel Corporation
 *
 * SPDX-License-Identifier: Apache-2.0
 */

#include <zephyr/sys/printk.h>
#include <zephyr/bluetooth/bluetooth.h>
#include <zephyr/bluetooth/hci.h>

#define NAME_LEN 30

static void device_found(const bt_addr_le_t *addr, int8_t rssi, uint8_t type,
			 struct net_buf_simple *ad)
{
	char addr_str[BT_ADDR_LE_STR_LEN];

	bt_addr_le_to_str(addr, addr_str, sizeof(addr_str));
	printk("Device found: %s (RSSI %d), type %u, AD data len %u\n",
	       addr_str, rssi, type, ad->len);
}

#if defined(CONFIG_BT_EXT_ADV)
static bool data_cb(struct bt_data *data, void *user_data)
{
	char *name = user_data;
	uint8_t len;

	switch (data->type) {
	case BT_DATA_NAME_SHORTENED:
	case BT_DATA_NAME_COMPLETE:
		len = MIN(data->data_len, NAME_LEN - 1);
		(void)memcpy(name, data->data, len);
		name[len] = '\0';
		return false;
	default:
		return true;
	}
}

static const char *phy2str(uint8_t phy)
{
	switch (phy) {
	case BT_GAP_LE_PHY_NONE: return "No packets";
	case BT_GAP_LE_PHY_1M: return "LE 1M";
	case BT_GAP_LE_PHY_2M: return "LE 2M";
	case BT_GAP_LE_PHY_CODED: return "LE Coded";
	default: return "Unknown";
	}
}

static void scan_recv(const struct bt_le_scan_recv_info *info,
		      struct net_buf_simple *buf)
{
	char le_addr[BT_ADDR_LE_STR_LEN];
	char name[NAME_LEN];
	uint8_t data_status;
	uint16_t data_len;

	(void)memset(name, 0, sizeof(name));

	data_len = buf->len;
	bt_data_parse(buf, data_cb, name);

	data_status = BT_HCI_LE_ADV_EVT_TYPE_DATA_STATUS(info->adv_props);

	bt_addr_le_to_str(info->addr, le_addr, sizeof(le_addr));
	printk("[DEVICE]: %s, AD evt type %u, Tx Pwr: %i, RSSI %i "
	       "Data status: %u, AD data len: %u Name: %s "
	       "C:%u S:%u D:%u SR:%u E:%u Pri PHY: %s, Sec PHY: %s, "
	       "Interval: 0x%04x (%u ms), SID: %u\n",
	       le_addr, info->adv_type, info->tx_power, info->rssi,
	       data_status, data_len, name,
	       (info->adv_props & BT_GAP_ADV_PROP_CONNECTABLE) != 0,
	       (info->adv_props & BT_GAP_ADV_PROP_SCANNABLE) != 0,
	       (info->adv_props & BT_GAP_ADV_PROP_DIRECTED) != 0,
	       (info->adv_props & BT_GAP_ADV_PROP_SCAN_RESPONSE) != 0,
	       (info->adv_props & BT_GAP_ADV_PROP_EXT_ADV) != 0,
	       phy2str(info->primary_phy), phy2str(info->secondary_phy),
	       info->interval, info->interval * 5 / 4, info->sid);
}

static struct bt_le_scan_cb scan_callbacks = {
	.recv = scan_recv,
};
#endif /* CONFIG_BT_EXT_ADV */

int observer_start(void)
{
	struct bt_le_scan_param scan_param = {
		.type       = BT_LE_SCAN_TYPE_PASSIVE,
		//.type       = BT_LE_SCAN_TYPE_ACTIVE,
		.options    = BT_LE_SCAN_OPT_FILTER_DUPLICATE,
		//.interval   = BT_GAP_SCAN_FAST_INTERVAL,
		//.window     = BT_GAP_SCAN_FAST_WINDOW,
		.interval   = BT_GAP_SCAN_SLOW_INTERVAL_2,    // 0x1000
		//.window     = BT_GAP_SCAN_SLOW_WINDOW_2,      // 0x0012
		.window     = 0x1000,
	};
	int err;

#if defined(CONFIG_BT_EXT_ADV)
	bt_le_scan_cb_register(&scan_callbacks);
	printk("Registered scan callbacks\n");
#endif /* CONFIG_BT_EXT_ADV */

	err = bt_le_scan_start(&scan_param, device_found);
	if (err) {
		printk("Start scanning failed (err %d)\n", err);
		return err;
	}
	printk("Started scanning...\n");

	return 0;
}
```
