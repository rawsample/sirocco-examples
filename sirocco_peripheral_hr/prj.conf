## CMakeLists.txt
```
# SPDX-License-Identifier: Apache-2.0

cmake_minimum_required(VERSION 3.20.0)

find_package(Zephyr REQUIRED HINTS $ENV{ZEPHYR_BASE})
project(sirocco_peripheral_hr)

FILE(GLOB app_sources src/*.c)
target_sources(app PRIVATE
  ${app_sources}
  )

zephyr_library_include_directories(${ZEPHYR_BASE}/samples/bluetooth)
```

## prj.conf
```kconfig
CONFIG_BT=y
CONFIG_LOG=y
CONFIG_BT_SMP=y
CONFIG_BT_PERIPHERAL=y
CONFIG_BT_DIS=y
CONFIG_BT_DIS_PNP=n
CONFIG_BT_BAS=y
CONFIG_BT_HRS=y
CONFIG_BT_DEVICE_NAME="Sirocco Heartrate Sensor"
CONFIG_BT_DEVICE_APPEARANCE=833

# Open source Link Layer
CONFIG_BT_LL_SW_SPLIT=y
# Enable library for nRF button and LED
CONFIG_BT_LBS=y
CONFIG_BT_LBS_POLL_BUTTON=y
CONFIG_DK_LIBRARY=y
#CONFIG_LOG_DEFAULT_LEVEL=4
#CONFIG_LOG_MODE_MINIMAL=y


# Enable Sirocco Bluetooth IDS
#
CONFIG_BT_SIROCCO=y
#CONFIG_BT_SRCC_LOG_LEVEL=4
#
# Sirocco dependencies
#
CONFIG_NRFX_TIMER2=y
#CONFIG_HEAP_MEM_POOL_SIZE=8192
CONFIG_HEAP_MEM_POOL_SIZE=32768
CONFIG_SYS_HASH_FUNC32=y
CONFIG_SYS_HASH_MAP=y
#
# Enable detection modules
#
#CONFIG_BT_SRCC_BTLEJUICE=y
#CONFIG_BT_SRCC_OASIS_GATTACKER=y
#CONFIG_BT_SRCC_INJECTABLE=y
#CONFIG_BT_SRCC_KNOB=y
#
# Detection module dependencies
#
# Enable Observer for BTLEJuice module for scanning
#CONFIG_BT_OBSERVER=y
# Enable ring buffer for Oasis GATTacker module
#CONFIG_RING_BUFFER=y


# Remove some stuff to make attacks easier to success
#
CONFIG_BT_CTLR_CHAN_SEL_2=n
CONFIG_BT_CTLR_ADV_EXT=n

CONFIG_BT_CTLR_PHY_2M=n
CONFIG_BT_GAP_AUTO_UPDATE_CONN_PARAMS=n
CONFIG_BT_CTLR_CONN_PARAM_REQ=n


# To measure Sirocco performances
#
#CONFIG_NRFX_TIMER3=y
#CONFIG_SRCC_ANALYSIS=y
#CONFIG_SRCC_ISR_LATENCY=y
#CONFIG_SRCC_FIFO_LATENCY=y
#CONFIG_SRCC_E2E_LATENCY=y
```

## src/main.c
```c
/* main.c - Application main entry point */

/*
 * Copyright (c) 2015-2016 Intel Corporation
 *
 * SPDX-License-Identifier: Apache-2.0
 */

#include <zephyr/types.h>
#include <stddef.h>
#include <string.h>
#include <errno.h>
#include <zephyr/sys/printk.h>
#include <zephyr/sys/byteorder.h>
#include <zephyr/kernel.h>

#include <zephyr/bluetooth/bluetooth.h>
#include <zephyr/bluetooth/hci.h>
#include <zephyr/bluetooth/conn.h>
#include <zephyr/bluetooth/uuid.h>
#include <zephyr/bluetooth/gatt.h>
#include <zephyr/bluetooth/services/bas.h>
#include <zephyr/bluetooth/services/hrs.h>
#include <zephyr/bluetooth/controller.h>

#include <bluetooth/services/lbs.h>

#include <dk_buttons_and_leds.h>

#include <zephyr/bluetooth/sirocco.h>


#define RUN_STATUS_LED	DK_LED1
#define CON_STATUS_LED	DK_LED2
#define USER_LED        DK_LED3
#define USER_BUTTON     DK_BTN1_MSK

static bool app_button_state;

/* Define multiple speed for advertising */
#define SLOOOW_ADV BT_LE_ADV_PARAM(BT_LE_ADV_OPT_CONNECTABLE | BT_LE_ADV_OPT_USE_NAME, \
                                   0x1000, 0x1100, NULL)
#define SLOOW_ADV BT_LE_ADV_PARAM(BT_LE_ADV_OPT_CONNECTABLE | BT_LE_ADV_OPT_USE_NAME, \
                                   0x500, 0x600, NULL)
#define SLOW_ADV BT_LE_ADV_PARAM(BT_LE_ADV_OPT_CONNECTABLE | BT_LE_ADV_OPT_USE_NAME, \
                                 0x200, 0x250, NULL)
#define MID_ADV BT_LE_ADV_PARAM(BT_LE_ADV_OPT_CONNECTABLE | BT_LE_ADV_OPT_USE_NAME, \
                                0x100, 0x120, NULL)
#define FAST_ADV BT_LE_ADV_PARAM(BT_LE_ADV_OPT_CONNECTABLE | BT_LE_ADV_OPT_USE_NAME, \
                                 0x30, 0x40, NULL)

/* Advertise only on the channel 37 */
#define SLOW_ADV_37 BT_LE_ADV_PARAM(BT_LE_ADV_OPT_CONNECTABLE | BT_LE_ADV_OPT_USE_NAME | BT_LE_ADV_OPT_DISABLE_CHAN_38 | BT_LE_ADV_OPT_DISABLE_CHAN_39, \
                                 0x200, 0x250, NULL)


static const struct bt_data ad[] = {
	BT_DATA_BYTES(BT_DATA_FLAGS, (BT_LE_AD_GENERAL | BT_LE_AD_NO_BREDR)),
	BT_DATA_BYTES(BT_DATA_UUID16_ALL,
		      BT_UUID_16_ENCODE(BT_UUID_HRS_VAL),
		      BT_UUID_16_ENCODE(BT_UUID_BAS_VAL),
		      BT_UUID_16_ENCODE(BT_UUID_DIS_VAL))
};

static void connected(struct bt_conn *conn, uint8_t err)
{
	if (err) {
		printk("Connection failed (err 0x%02x)\n", err);
	} else {
		dk_set_led_on(CON_STATUS_LED);

		struct bt_conn_info info;
		char addr_str[BT_ADDR_LE_STR_LEN];

		bt_conn_get_info(conn, &info);
		bt_addr_le_to_str(info.le.dst, addr_str, sizeof(addr_str));

		printk("Connected with %s\n", addr_str);
	}
}

static void disconnected(struct bt_conn *conn, uint8_t reason)
{
	struct bt_conn_info info;
	char addr_str[BT_ADDR_LE_STR_LEN];

	bt_conn_get_info(conn, &info);
	bt_addr_le_to_str(info.le.dst, addr_str, sizeof(addr_str));

	printk("Disconnected with %s (reason 0x%02x)\n", addr_str, reason);
	dk_set_led_off(CON_STATUS_LED);
}

BT_CONN_CB_DEFINE(conn_callbacks) = {
	.connected = connected,
	.disconnected = disconnected,
};

static void bt_ready(void)
{
	int err;

	printk("Bluetooth initialized\n");

	err = bt_le_adv_start(SLOW_ADV_37, ad, ARRAY_SIZE(ad), NULL, 0);
	if (err) {
		printk("Advertising failed to start (err %d)\n", err);
		return;
	}

	printk("Advertising successfully started\n");
}

static void auth_cancel(struct bt_conn *conn)
{
	char addr[BT_ADDR_LE_STR_LEN];

	bt_addr_le_to_str(bt_conn_get_dst(conn), addr, sizeof(addr));

	printk("Pairing cancelled: %s\n", addr);
}

static struct bt_conn_auth_cb auth_cb_display = {
	.cancel = auth_cancel,
};

/* Services */

static void bas_notify(void)
{
	uint8_t battery_level = bt_bas_get_battery_level();

	battery_level--;

	if (!battery_level) {
		battery_level = 100U;
	}

	bt_bas_set_battery_level(battery_level);
}

static void hrs_notify(void)
{
	static uint8_t heartrate = 90U;

	/* Heartrate measurements simulation */
	heartrate++;
	if (heartrate == 160U) {
		heartrate = 90U;
	}

	bt_hrs_notify(heartrate);
}


static void app_led_cb(bool led_state)
{
	dk_set_led(USER_LED, led_state);
}

static bool app_button_cb(void)
{
	return app_button_state;
}

static struct bt_lbs_cb lbs_callbacs = {
	.led_cb    = app_led_cb,
	.button_cb = app_button_cb,
};

static void button_changed(uint32_t button_state, uint32_t has_changed)
{
	if (has_changed & USER_BUTTON) {
		uint32_t user_button_state = button_state & USER_BUTTON;

		bt_lbs_send_button_state(user_button_state);
		app_button_state = user_button_state ? true : false;
	}
}

static int init_button(void)
{
	int err;

	err = dk_buttons_init(button_changed);
	if (err) {
		printk("Cannot init buttons (err: %d)\n", err);
	}

	return err;
}


int main(void)
{
	int err;
	int blink_status = 0;
    /* Use a known fixed address to ease development */
    const uint8_t public_addr[BDADDR_SIZE] = {0xaa, 0xaa, 0xef, 0xbe, 0xad, 0xde};

	/* Initialize LEDs and button
	 */
	err = dk_leds_init();
	if (err) {
		printk("LEDs init failed (err %d)\n", err);
		return 0;
	}

	err = init_button();
	if (err) {
		printk("Button init failed (err %d)\n", err);
		return 0;
	}
	printk("LEDs & button initialized\n");

    /* Set advertising address */
    bt_ctlr_set_public_addr((const uint8_t *) &public_addr);

	/* Initialize Bluetooth
	 */
	err = bt_enable(NULL);
	if (err) {
		printk("Bluetooth init failed (err %d)\n", err);
		return 0;
	}
	printk("Bluetooth initialized\n");

    /* Initialize LEDs and button callbacks
    */
	err = bt_lbs_init(&lbs_callbacs);
	if (err) {
		printk("Failed to init LBS (err:%d)\n", err);
		return 0;
	}

    /* Initialized latency analysis
     */
#if defined(CONFIG_SRCC_ANALYSIS)
    init_srcc_analysis();
#endif

    /* Initialized Sirocco IDS 
     */
 #if defined(CONFIG_BT_SIROCCO)
	srcc_init();
	printk("Sirocco Bluetooth IDS initialized\n");
#endif

	/* Start advertising */
	bt_ready();
	bt_conn_auth_cb_register(&auth_cb_display);


	/* Implement notification. At the moment there is no suitable way
	 * of starting delayed work so we do it here
	 */
	while (1) {
		k_sleep(K_SECONDS(1));

		/* Blink the LED */
		dk_set_led(RUN_STATUS_LED, (++blink_status) % 2);

		/* Heartrate measurements simulation */
		hrs_notify();

		/* Battery level simulation */
		bas_notify();
	}
	return 0;
}
```

## src/detect_btlejuice.c
```c
/*
 */
#include <zephyr/sys/printk.h>

#include <zephyr/bluetooth/bluetooth.h>
#include <zephyr/bluetooth/addr.h>

#include "detect_btlejuice.h"


#define SRCC_BTLEJUICE_SCAN_INTERVAL    0x0010
#define SRCC_BTLEJUICE_SCAN_WINDOW      0x0010


static bool is_scanning = false;


static void sirocco_btlejuice_cb(const bt_addr_le_t *remote_addr, int8_t rssi, uint8_t adv_type,
		    struct net_buf_simple *buf)
{
    /* Print scanned devices 
	char addr_str[BT_ADDR_LE_STR_LEN];

	bt_addr_le_to_str(remote_addr, addr_str, BT_ADDR_LE_STR_LEN);
    // TODO: check returned value by bt_addr_le_to_str
	printk("[BTLEJUICE]: %s, ADV evt type %u, ADV data len %u, RSSI %i\n",
	       addr_str, adv_type, buf->len, rssi);
    */

	char laddr_str[BT_ADDR_LE_STR_LEN];
	char raddr_str[BT_ADDR_LE_STR_LEN];

	bt_addr_le_t local_addrs[CONFIG_BT_ID_MAX];
	size_t count = 1;
    int res = 0;

	bt_id_get(local_addrs, &count);
    //printk("%d\n", count);

    for (int i=0; i<count; i++) {
        bt_addr_le_to_str(&local_addrs[i], laddr_str, BT_ADDR_LE_STR_LEN);
        bt_addr_le_to_str(remote_addr, raddr_str, BT_ADDR_LE_STR_LEN);

        //if (bt_addr_le_eq(&local_addrs[i], remote_addr)) {
        //if (bt_addr_le_cmp(&local_addrs[i], remote_addr) == 0) {
        //res = bt_addr_le_cmp(&local_addrs[i], remote_addr);
        res = bt_addr_cmp(&remote_addr->a, &local_addrs[i].a);
        if (res == 0) {
            printk(">>> [SIROCCO] BTLEJuice attack detected !!!\n");
        }
        //printk("local: %s ? remote: %s res = %d\n", laddr_str, raddr_str, res);
    }

}

/*
int sirocco_btlejuice_init()
{
    return 0;
}
*/

int sirocco_btlejuice_start()
{
    int err;
    struct bt_le_scan_param scan_param = {
        .type       = BT_LE_SCAN_TYPE_PASSIVE,
        .options    = BT_LE_SCAN_OPT_NONE,
        .interval   = SRCC_BTLEJUICE_SCAN_INTERVAL,
        .window     = SRCC_BTLEJUICE_SCAN_WINDOW,
    };

    /* Start scanning */
	err = bt_le_scan_start(&scan_param, sirocco_btlejuice_cb);
	if (err) {
		printk("Starting scanning failed (err %d)\n", err);
		return 1;
	}

    is_scanning = true;
    printk("Sirocco BTLEJuice module started\n");

    return 0;
}

int sirocco_btlejuice_stop()
{
    int err;

	err = bt_le_scan_stop();
	if (err) {
		printk("Stopping scanning failed (err %d)\n", err);
		return 1;
	}

    is_scanning = false;
    printk("Sirocco BTLEJuice module stopped\n");

    return 0;
}
```

## src/detect_btlejuice.h
```c
#ifndef SRCC_BTLEJUICE_H
#define SRCC_BTLEJUICE_H
int sirocco_btlejuice_start();
int sirocco_btlejuice_stop();
#endif
```
